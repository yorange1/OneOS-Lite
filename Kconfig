## components/molink/module/a7600x/Kconfig
```kconfig
menu "Config"

    config A7600X_USING_GENERAL_OPS
        bool "General Operates"
        select MOLINK_USING_GENERAL_OPS
        default n

    config A7600X_USING_NETSERV_OPS
        bool "Network Service"
        select MOLINK_USING_NETSERV_OPS
        default n

    config A7600X_USING_PING_OPS
        bool #"Ping"
        select MOLINK_USING_PING_OPS
        default n

    config A7600X_USING_IFCONFIG_OPS
        bool #"Ifconfig"
        select MOLINK_USING_IFCONFIG_OPS
        select A7600X_USING_GENERAL_OPS
        select A7600X_USING_NETSERV_OPS
        default n

    config A7600X_USING_NETCONN_OPS
        bool "Netconn Options"
        select MOLINK_USING_NETCONN_OPS
        default y
        
    if A7600X_USING_NETCONN_OPS
        config A7600X_USING_TCP
            bool "TCP"
            select MOLINK_USING_TCP
            default y

        config A7600X_USING_UDP
            bool "UDP"
            select MOLINK_USING_UDP
            default y

        config A7600X_USING_SELECT
            bool "Select"
            select MOLINK_USING_SELECT
            default n

        config A7600X_USING_DNS
            bool "DNS"
            select MOLINK_USING_DNS
            default y

        config A7600X_USING_ADDRINFO
            bool "AddrInfo"
            select A7600X_USING_DNS
            select MOLINK_USING_ADDRINFO
            default n
    endif

    config A7600X_USING_SOCKETS_OPS
        bool "BSD Socket"
        select A7600X_USING_NETCONN_OPS
        select MOLINK_USING_SOCKETS_OPS
        default n

endmenu
```

## components/molink/module/air720uh/Kconfig
```kconfig
menu "Config"

    config AIR720UH_USING_GENERAL_OPS
        bool "General Operates"
        select MOLINK_USING_GENERAL_OPS
        default n

    config AIR720UH_USING_NETSERV_OPS
        bool "Network Service"
        select MOLINK_USING_NETSERV_OPS
        default n

    config AIR720UH_USING_PING_OPS
        bool #"Ping"
        select MOLINK_USING_NETSERV_OPS
        select MOLINK_USING_PING_OPS
        default n

    config AIR720UH_USING_IFCONFIG_OPS
        bool #"Ifconfig"
        select MOLINK_USING_IFCONFIG_OPS
        select AIR720UH_USING_GENERAL_OPS
        select AIR720UH_USING_NETSERV_OPS
        default n

    config AIR720UH_USING_NETCONN_OPS
        bool "Netconn Options"
        select OS_USING_EVENT
        select MOLINK_USING_NETCONN_OPS
        default y

    if AIR720UH_USING_NETCONN_OPS
        config AIR720UH_USING_TCP
            bool "TCP"
            select MOLINK_USING_TCP
            default y

        config AIR720UH_USING_UDP
            bool "UDP"
            select MOLINK_USING_UDP
            default y

        config AIR720UH_USING_SELECT
            bool "Select"
            select MOLINK_USING_SELECT
            default n

        config AIR720UH_USING_DNS
            bool "DNS"
            select MOLINK_USING_DNS
            default y

        config AIR720UH_USING_ADDRINFO
            bool "AddrInfo"
            select AIR720UH_USING_DNS
            select MOLINK_USING_ADDRINFO
            default n
    endif

    config AIR720UH_USING_SOCKETS_OPS
        bool "BSD Socket"
        select AIR720UH_USING_NETCONN_OPS
        select MOLINK_USING_SOCKETS_OPS
        default n

endmenu
```

## components/molink/module/bc20/Kconfig
```kconfig
menu "Config" 

    config BC20_USING_GENERAL_OPS
        bool "General Operates"
        select MOLINK_USING_GENERAL_OPS
        default n
    
    config BC20_USING_NETSERV_OPS
        bool "Network Service"
        select MOLINK_USING_NETSERV_OPS
        default n

    config BC20_USING_PING_OPS
        bool #"Ping"
        select MOLINK_USING_NETSERV_OPS
        select MOLINK_USING_PING_OPS
        default n

    config BC20_USING_IFCONFIG_OPS
        bool #"Ifconfig"
        select MOLINK_USING_IFCONFIG_OPS
        select BC20_USING_GENERAL_OPS
        select BC20_USING_NETSERV_OPS
        default n

    config BC20_USING_NETCONN_OPS
        bool "Netconn Options"
        select MOLINK_USING_NETCONN_OPS
        select BC20_USING_NETSERV_OPS
        default y

    if BC20_USING_NETCONN_OPS
        config BC20_USING_TCP
            bool "TCP"
            select MOLINK_USING_TCP
            default y

        config BC20_USING_UDP
            bool "UDP"
            select MOLINK_USING_UDP
            default y

        config BC20_USING_SELECT
            bool "Select"
            select MOLINK_USING_SELECT
            default n

        config BC20_USING_DNS
            bool "DNS"
            select MOLINK_USING_DNS
            default y

        config BC20_USING_ADDRINFO
            bool "AddrInfo"
            select BC20_USING_DNS
            select MOLINK_USING_ADDRINFO
            default n
    endif

    config BC20_USING_SOCKETS_OPS
        bool "BSD Socket"
        select BC20_USING_NETCONN_OPS
        select MOLINK_USING_SOCKETS_OPS
        default n

endmenu
```

## components/molink/module/bc26/Kconfig
```kconfig
menu "Config" 

    config BC26_USING_GENERAL_OPS
        bool "General Operates"
        select MOLINK_USING_GENERAL_OPS
        default n
    
    config BC26_USING_NETSERV_OPS
        bool "Network Service"
        select MOLINK_USING_NETSERV_OPS
        default n

    config BC26_USING_PING_OPS
        bool #"Ping"
        select MOLINK_USING_NETSERV_OPS
        select MOLINK_USING_PING_OPS
        default n

    config BC26_USING_IFCONFIG_OPS
        bool #"Ifconfig"
        select MOLINK_USING_IFCONFIG_OPS
        select BC26_USING_GENERAL_OPS
        select BC26_USING_NETSERV_OPS
        default n

    config BC26_USING_NETCONN_OPS
        bool "Netconn Options"
        select MOLINK_USING_NETCONN_OPS
        select BC26_USING_NETSERV_OPS
        default y

    if BC26_USING_NETCONN_OPS
        config BC26_USING_TCP
            bool "TCP"
            select MOLINK_USING_TCP
            default y

        config BC26_USING_UDP
            bool "UDP"
            select MOLINK_USING_UDP
            default y

        config BC26_USING_SELECT
            bool "Select"
            select MOLINK_USING_SELECT
            default n

        config BC26_USING_DNS
            bool "DNS"
            select MOLINK_USING_DNS
            default y

        config BC26_USING_ADDRINFO
            bool "AddrInfo"
            select BC26_USING_DNS
            select MOLINK_USING_ADDRINFO
            default n
    endif

    config BC26_USING_SOCKETS_OPS
        bool "BSD Socket"
        select BC26_USING_NETCONN_OPS
        select MOLINK_USING_SOCKETS_OPS
        default n

endmenu
```

## components/molink/module/bc95/Kconfig
```kconfig
menu "Config" 

    config BC95_USING_GENERAL_OPS
        bool "General Operates"
        select MOLINK_USING_GENERAL_OPS
        default n
    
    config BC95_USING_NETSERV_OPS
        bool "Network Service"
        select MOLINK_USING_NETSERV_OPS
        default n

    config BC95_USING_PING_OPS
        bool #"Ping"
        select BC95_USING_NETSERV_OPS
        select BC95_USING_NETCONN_OPS
        select MOLINK_USING_PING_OPS
        default n

    config BC95_USING_IFCONFIG_OPS
        bool #"Ifconfig"
        select MOLINK_USING_IFCONFIG_OPS
        select BC95_USING_GENERAL_OPS
        select BC95_USING_NETSERV_OPS
        default n

    config BC95_USING_NETCONN_OPS
        bool "Netconn Options"
        select BC95_USING_NETSERV_OPS
        select MOLINK_USING_NETCONN_OPS
        select MOLINK_USING_MO_LIB
        default y

    if BC95_USING_NETCONN_OPS
        config BC95_USING_TCP
            bool "TCP"
            select MOLINK_USING_TCP
            default y

        config BC95_USING_UDP
            bool "UDP"
            select MOLINK_USING_UDP
            default y

        config BC95_USING_SELECT
            bool "Select"
            select MOLINK_USING_SELECT
            default n

        config BC95_USING_DNS
            bool "DNS"
            select MOLINK_USING_DNS
            default y

        config BC95_USING_ADDRINFO
            bool "AddrInfo"
            select BC95_USING_DNS
            select MOLINK_USING_ADDRINFO
            default n
    endif

    config BC95_USING_SOCKETS_OPS
        bool "BSD Socket"
        select BC95_USING_NETCONN_OPS
        select MOLINK_USING_SOCKETS_OPS
        default n

#    config BC95_USING_ONENET_NB_OPS
#        bool "Onenet Nb"
#        select MOLINK_USING_ONENET_NB_OPS
#        default y
#
#    if BC95_USING_ONENET_NB_OPS
#
#        config BC95_RESP_BUFF_SIZE
#            int "OneNET AT Parser stack size"
#            default 128
#
#        config BC95_URC_MANAGER_TASK_PRIORITY
#            hex "URC manager task priority"
#            default 0x10
#
#        config BC95_URC_MANAGER_STACK_SIZE
#            int "URC manager task stack size"
#            default 2048
#
#    endif

endmenu
```

## components/molink/module/clm920rv3/Kconfig
```kconfig
menu "Config" 

    config CLM920RV3_USING_GENERAL_OPS
        bool "General Operates"
        select MOLINK_USING_GENERAL_OPS
        default n
    
    config CLM920RV3_USING_NETSERV_OPS
        bool "Network Service"
        select MOLINK_USING_NETSERV_OPS
        default n

    config CLM920RV3_USING_PING_OPS
        bool "test Ping(Only for test use)"
        select MOLINK_USING_PING_OPS
        default n

    config CLM920RV3_USING_IFCONFIG_OPS
        bool #"Ifconfig"
        select MOLINK_USING_IFCONFIG_OPS
        select CLM920RV3_USING_GENERAL_OPS
        select CLM920RV3_USING_NETSERV_OPS
        select CLM920RV3_USING_NETCONN_OPS
        default n

    config CLM920RV3_USING_NETCONN_OPS
        bool "Netconn Options"
        select OS_USING_EVENT
        select MOLINK_USING_NETCONN_OPS
        default y

    if CLM920RV3_USING_NETCONN_OPS
        config CLM920RV3_USING_TCP
            bool "TCP"
            select MOLINK_USING_TCP
            default y

        config CLM920RV3_USING_UDP
            bool "UDP"
            select MOLINK_USING_UDP
            default y

        config CLM920RV3_USING_SELECT
            bool "Select"
            select MOLINK_USING_SELECT
            default n

        config CLM920RV3_USING_DNS
            bool "DNS"
            select MOLINK_USING_DNS
            default y

        config CLM920RV3_USING_ADDRINFO
            bool "AddrInfo"
            select CLM920RV3_USING_DNS
            select MOLINK_USING_ADDRINFO
            default n
    endif

    config CLM920RV3_USING_SOCKETS_OPS
        bool "BSD Socket"
        select CLM920RV3_USING_NETCONN_OPS
        select MOLINK_USING_SOCKETS_OPS
        default n

endmenu
```

## components/molink/module/e7025/Kconfig
```kconfig
menu "Config" 

    config E7025_USING_GENERAL_OPS
        bool "General Operates"
        select MOLINK_USING_GENERAL_OPS
        default n
    
    config E7025_USING_NETSERV_OPS
        bool "Network Service"
        select MOLINK_USING_NETSERV_OPS
        default n

    config E7025_USING_PING_OPS
        bool #"Ping"
        select MOLINK_USING_PING_OPS
        default n

    config E7025_USING_IFCONFIG_OPS
        bool #"Ifconfig"
        select MOLINK_USING_IFCONFIG_OPS
        select E7025_USING_GENERAL_OPS
        select E7025_USING_NETSERV_OPS
        default n

    config E7025_USING_NETCONN_OPS
        bool "Netconn Options"
        select MOLINK_USING_NETCONN_OPS
        select MOLINK_USING_MO_LIB
        default y

    if E7025_USING_NETCONN_OPS
        config E7025_USING_TCP
            bool "TCP"
            select MOLINK_USING_TCP
            default y

        config E7025_USING_UDP
            bool "UDP"
            select MOLINK_USING_UDP
            default y

        config E7025_USING_SELECT
            bool "Select"
            select MOLINK_USING_SELECT
            default n

        config E7025_USING_DNS
            bool "DNS"
            select MOLINK_USING_DNS
            default y

        config E7025_USING_ADDRINFO
            bool "AddrInfo"
            select E7025_USING_DNS
            select MOLINK_USING_ADDRINFO
            default n
    endif

    config E7025_USING_SOCKETS_OPS
        bool "BSD Socket"
        select E7025_USING_NETCONN_OPS
        select MOLINK_USING_SOCKETS_OPS
        default n

endmenu
```

## components/molink/module/ec20/Kconfig
```kconfig
menu "Config" 

    config EC20_USING_GENERAL_OPS
        bool "General Operates"
        select MOLINK_USING_GENERAL_OPS
        default n
    
    config EC20_USING_NETSERV_OPS
        bool "Network Service"
        select MOLINK_USING_NETSERV_OPS
        default n

    config EC20_USING_PING_OPS
        bool #"Ping"
        select MOLINK_USING_PING_OPS
        default n

    config EC20_USING_IFCONFIG_OPS
        bool #"Ifconfig"
        select MOLINK_USING_IFCONFIG_OPS
        select EC20_USING_GENERAL_OPS
        select EC20_USING_NETSERV_OPS
        select EC20_USING_NETCONN_OPS
        default n

    config EC20_USING_NETCONN_OPS
        bool "Netconn Options"
        select OS_USING_EVENT
        select MOLINK_USING_NETCONN_OPS
        default y

    if EC20_USING_NETCONN_OPS
        config EC20_USING_TCP
            bool "TCP"
            select MOLINK_USING_TCP
            default y

        config EC20_USING_UDP
            bool "UDP"
            select MOLINK_USING_UDP
            default y

        config EC20_USING_SELECT
            bool "Select"
            select MOLINK_USING_SELECT
            default n

        config EC20_USING_DNS
            bool "DNS"
            select MOLINK_USING_DNS
            default y

        config EC20_USING_ADDRINFO
            bool "AddrInfo"
            select SIM7600CE_USING_DNS
            select MOLINK_USING_ADDRINFO
            default n
    endif

    config EC20_USING_SOCKETS_OPS
        bool "BSD Socket"
        select EC20_USING_NETCONN_OPS
        select MOLINK_USING_SOCKETS_OPS
        default n

#   config EC20_USING_PPP_OPS
#        bool "PPPoS"
#       select MOLINK_USING_PPP_OPS
#       select MOLINK_USING_GENERAL_OPS
#       select MOLINK_USING_NETSERV_OPS
#       select NET_USING_LWIP
#       select LWIP_USING_PPP
#       select LWIP_USING_PPPOS
#       default n

endmenu
```

## components/molink/module/ec200x_600s/Kconfig
```kconfig
menu "Config"

    config EC200X_600S_USING_GENERAL_OPS
        bool "General Operates"
        select MOLINK_USING_GENERAL_OPS
        default n

    config EC200X_600S_USING_NETSERV_OPS
        bool "Network Service"
        select MOLINK_USING_NETSERV_OPS
        default n

    config EC200X_600S_USING_PING_OPS
        bool #"Ping"
        select MOLINK_USING_NETSERV_OPS
        select MOLINK_USING_PING_OPS
        default n

    config EC200X_600S_USING_IFCONFIG_OPS
        bool #"Ifconfig"
        select MOLINK_USING_IFCONFIG_OPS
        select EC200X_600S_USING_GENERAL_OPS
        select EC200X_600S_USING_NETSERV_OPS
        default n

    config EC200X_600S_USING_NETCONN_OPS
        bool "Netconn Options"
        select OS_USING_EVENT
        select MOLINK_USING_NETCONN_OPS
        default y

    if EC200X_600S_USING_NETCONN_OPS
        config EC200X_600S_USING_TCP
            bool "TCP"
            select MOLINK_USING_TCP
            default y

        config EC200X_600S_USING_UDP
            bool "UDP"
            select MOLINK_USING_UDP
            default y

        config EC200X_600S_USING_SELECT
            bool "Select"
            select MOLINK_USING_SELECT
            default n

        config EC200X_600S_USING_DNS
            bool "DNS"
            select MOLINK_USING_DNS
            default y

        config EC200X_600S_USING_ADDRINFO
            bool "AddrInfo"
            select EC200X_600S_USING_DNS
            select MOLINK_USING_ADDRINFO
            default n
    endif

    config EC200X_600S_USING_SOCKETS_OPS
        bool "BSD Socket"
        select EC200X_600S_USING_NETCONN_OPS
        select MOLINK_USING_SOCKETS_OPS
        default n

endmenu
```
