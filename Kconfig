## components/molink/module/esp32/Kconfig
```kconfig
menu "Config"

    config ESP32_CONNECT_SSID
        string "AP SSID"
        default "ssid"

    config ESP32_CONNECT_PASSWORD
        string "AP Password"
        default "password"

    config ESP32_USING_GENERAL_OPS
        bool "General Operates"
        select MOLINK_USING_GENERAL_OPS
        default n

    config ESP32_USING_WIFI_OPS
        bool "WiFi"
        select MOLINK_USING_WIFI_OPS
        default n

    config ESP32_USING_PING_OPS
        bool #"Ping"
        select MOLINK_USING_PING_OPS
        default n

    config ESP32_USING_IFCONFIG_OPS
        bool #"Ifconfig"
        select MOLINK_USING_IFCONFIG_OPS
        select ESP32_USING_WIFI_OPS
        default n

    config ESP32_USING_NETCONN_OPS
        bool "Netconn Options"
        select OS_USING_EVENT
        select MOLINK_USING_NETCONN_OPS
        default y

    if ESP32_USING_NETCONN_OPS
        config ESP32_USING_TCP
            bool "TCP"
            select MOLINK_USING_TCP
            default y

        config ESP32_USING_UDP
            bool "UDP"
            select MOLINK_USING_UDP
            default y

        config ESP32_USING_SELECT
            bool "Select"
            select MOLINK_USING_SELECT
            default n

        config ESP32_USING_DNS
            bool "DNS"
            select MOLINK_USING_DNS
            default y

        config ESP32_USING_ADDRINFO
            bool "AddrInfo"
            select ESP32_USING_DNS
            select MOLINK_USING_ADDRINFO
            default n
    endif

    config ESP32_USING_SOCKETS_OPS
        bool "BSD Socket"
        select ESP32_USING_NETCONN_OPS
        select MOLINK_USING_SOCKETS_OPS
        default n

endmenu
```

## components/molink/module/esp8266/Kconfig
```kconfig
menu "Config" 

    config ESP8266_CONNECT_SSID
        string "AP SSID"
        default "ssid"

    config ESP8266_CONNECT_PASSWORD
        string "AP Password"
        default "password"

    config ESP8266_USING_GENERAL_OPS
        bool "General Operates"
        select MOLINK_USING_GENERAL_OPS
        default n

    config ESP8266_USING_WIFI_OPS
        bool "WiFi"
        select MOLINK_USING_WIFI_OPS
        default n

    config ESP8266_USING_PING_OPS
        bool #"Ping"
        select MOLINK_USING_PING_OPS
        default n

    config ESP8266_USING_IFCONFIG_OPS
        bool #"Ifconfig"
        select MOLINK_USING_IFCONFIG_OPS
        select ESP8266_USING_WIFI_OPS
        default n

    config ESP8266_USING_NETCONN_OPS
        bool "Netconn Options"
        select OS_USING_EVENT
        select MOLINK_USING_NETCONN_OPS
        default y

    if ESP8266_USING_NETCONN_OPS
        config ESP8266_USING_IPV6
            bool #"IPv6"
            default n

        config ESP8266_USING_TCP
            bool "TCP"
            select MOLINK_USING_TCP
            default y

        config ESP8266_USING_UDP
            bool "UDP"
            select MOLINK_USING_UDP
            default y

        config ESP8266_USING_SELECT
            bool "Select"
            select MOLINK_USING_SELECT
            default n

        config ESP8266_USING_DNS
            bool "DNS"
            select MOLINK_USING_DNS
            default y

        config ESP8266_USING_ADDRINFO
            bool "AddrInfo"
            select ESP8266_USING_DNS
            select MOLINK_USING_ADDRINFO
            default n
    endif

    config ESP8266_USING_SOCKETS_OPS
        bool "BSD Socket"
        select ESP8266_USING_NETCONN_OPS
        select MOLINK_USING_SOCKETS_OPS
        default n

    config ESP8266_USING_HW_CONTROL
        bool "Hardware Control"
        select OS_USING_PIN
        default n

        if ESP8266_USING_HW_CONTROL
            config ESP8266_RST_PIN_NUM
                int "Reset Pin Number"
                help 
                    This can be calculated using GET_PIN(PORTx, PIN)
                default -1

        endif
endmenu
```

## components/molink/module/gm120/Kconfig
```kconfig
menu "Config" 

    config GM120_USING_GENERAL_OPS
        bool "General Operates"
        select MOLINK_USING_GENERAL_OPS
        default n

    config GM120_USING_NETSERV_OPS
        bool "Network Service"
        select MOLINK_USING_NETSERV_OPS
        default n
		
    config GM120_USING_PING_OPS
        bool #"Ping"
        select MOLINK_USING_PING_OPS
        default n
		
    config GM120_USING_IFCONFIG_OPS
        bool #"Ifconfig"
        select MOLINK_USING_IFCONFIG_OPS
        select GM120_USING_GENERAL_OPS
        select GM120_USING_NETSERV_OPS
        default n
		
    config GM120_USING_NETCONN_OPS
        bool "Netconn Options"
        select MOLINK_USING_NETCONN_OPS
        default y

    if GM120_USING_NETCONN_OPS
        config GM120_USING_TCP
            bool "TCP"
            select MOLINK_USING_TCP
            default y

        config GM120_USING_UDP
            bool "UDP"
            select MOLINK_USING_UDP
            default y

        config GM120_USING_SELECT
            bool "Select"
            select MOLINK_USING_SELECT
            default n

        config GM120_USING_DNS
            bool "DNS"
            select MOLINK_USING_DNS
            default y

        config GM120_USING_ADDRINFO
            bool "AddrInfo"
            select GM120_USING_DNS
            select MOLINK_USING_ADDRINFO
            default n
    endif

    config GM120_USING_SOCKETS_OPS
        bool "BSD Socket"
        select GM120_USING_NETCONN_OPS
        select MOLINK_USING_SOCKETS_OPS
        default n

endmenu
```

## components/molink/module/gm190/Kconfig
```kconfig
menu "Config" 

    config GM190_USING_GENERAL_OPS
        bool "General Operates"
        select MOLINK_USING_GENERAL_OPS
        default n
		
    config GM190_USING_NETSERV_OPS
        bool "Network Service"
        select MOLINK_USING_NETSERV_OPS
        default n

    config GM190_USING_IFCONFIG_OPS
        bool #"Ifconfig"
        select MOLINK_USING_IFCONFIG_OPS
        select GM190_USING_GENERAL_OPS
        select GM190_USING_NETSERV_OPS
        default n
		
    config GM190_USING_NETCONN_OPS
        bool "Netconn Options"
        select MOLINK_USING_NETCONN_OPS
        default y

    if GM190_USING_NETCONN_OPS
        config GM190_USING_TCP
            bool "TCP"
            select MOLINK_USING_TCP
            default y

        config GM190_USING_UDP
            bool "UDP"
            select MOLINK_USING_UDP
            default y

        config GM190_USING_SELECT
            bool "Select"
            select MOLINK_USING_SELECT
            default n

        config GM190_USING_DNS
            bool "DNS"
            select MOLINK_USING_DNS
            default y

        config GM190_USING_ADDRINFO
            bool "AddrInfo"
            select GM190_USING_DNS
            select MOLINK_USING_ADDRINFO
            default n
    endif

    config GM190_USING_SOCKETS_OPS
        bool "BSD Socket"
        select GM190_USING_NETCONN_OPS
        select MOLINK_USING_SOCKETS_OPS
        default n

endmenu
```

## components/molink/module/m5310a/Kconfig
```kconfig
menu "Config"

    config M5310A_USING_GENERAL_OPS
        bool "General Operates"
        select MOLINK_USING_GENERAL_OPS
        default n

    config M5310A_USING_NETSERV_OPS
        bool "Network Service"
        select MOLINK_USING_NETSERV_OPS
        default n

    config M5310A_USING_PING_OPS
        bool #"Ping"
        select MOLINK_USING_PING_OPS
        default n

    config M5310A_USING_IFCONFIG_OPS
        bool #"Ifconfig"
        select MOLINK_USING_IFCONFIG_OPS
        select M5310A_USING_GENERAL_OPS
        select M5310A_USING_NETSERV_OPS
        default n

    config M5310A_USING_NETCONN_OPS
        bool "Netconn Options"
        select MOLINK_USING_NETCONN_OPS
        select MOLINK_USING_MO_LIB
        default y

    if M5310A_USING_NETCONN_OPS
        config M5310A_USING_TCP
            bool "TCP"
            select MOLINK_USING_TCP
            default y

        config M5310A_USING_UDP
            bool "UDP"
            select MOLINK_USING_UDP
            default y

        config M5310A_USING_SELECT
            bool "Select"
            select MOLINK_USING_SELECT
            default n

        config M5310A_USING_DNS
            bool "DNS"
            select MOLINK_USING_DNS
            default y

        config M5310A_USING_ADDRINFO
            bool "AddrInfo"
            select M5310A_USING_DNS
            select MOLINK_USING_ADDRINFO
            default n
    endif

    config M5310_USING_SOCKETS_OPS
        bool "BSD Socket"
        select M5310A_USING_NETCONN_OPS
        select MOLINK_USING_SOCKETS_OPS
        default n

#    config M5310A_USING_ONENET_NB_OPS
#        bool "Onenet Nb"
#        select MOLINK_USING_ONENET_NB_OPS
#        select M5310A_USING_GENERAL_OPS
#        default y

endmenu
```
