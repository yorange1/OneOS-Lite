## Kconfig
```kconfig
source "$OS_ROOT/arch/Kconfig"
source "$OS_ROOT/oneos-kernel/Kconfig"
source "$OS_ROOT/drivers/Kconfig"
source "$OS_ROOT/components/Kconfig"
source "$OS_ROOT/thirdparty/Kconfig"
```

## components/Kconfig
```kconfig
menu "Components"
if !OS_MINIMAL_CONFIG
    source "$OS_ROOT/components/atest/Kconfig"
    source "$OS_ROOT/components/dlog/Kconfig"
endif
    source "$OS_ROOT/components/libc/Kconfig"
    source "$OS_ROOT/components/molink/Kconfig"
    source "$OS_ROOT/components/ota/Kconfig"
    source "$OS_ROOT/components/shell/Kconfig"
    source "$OS_ROOT/components/socket/Kconfig"
    source "$OS_ROOT/components/cplusplus/Kconfig"
endmenu
```

## components/atest/Kconfig
```kconfig
menu "Atest"
    config OS_USING_ATEST
        bool "atest"
        default n

    if OS_USING_ATEST
        config ATEST_TASK_STACK_SIZE
            int "atest task stack size"
            default 1024
        config ATEST_TASK_PRIORITY
            int "atest task priority"
            default 5  if OS_MINIMAL_CONFIG
            default 5  if OS_TASK_PRIORITY_8
            default 10  if OS_TASK_PRIORITY_16
            default 20  if OS_TASK_PRIORITY_32
            default 40  if OS_TASK_PRIORITY_64
            default 80  if OS_TASK_PRIORITY_128
            default 160 if OS_TASK_PRIORITY_256
    endif
endmenu
```

## components/cplusplus/Kconfig
```kconfig
menu "Cplusplus"
    config OS_USING_CPLUSPLUS
        bool "cplusplus"
        default n
endmenu
```

## components/libc/Kconfig
```kconfig
config OS_USING_NEWLIB_ADAPTER
    bool

config OS_USING_ARMCCLIB_ADAPTER
    bool

config OS_USING_LIBC_ADAPTER
    bool
    select OS_USING_NEWLIB_ADAPTER
    select OS_USING_ARMCCLIB_ADAPTER
```

## components/molink/Kconfig
```kconfig
menu "Molink"

config NET_USING_MOLINK
    bool "molink"
    select OS_USING_SYS_HEAP
    default n

if NET_USING_MOLINK

    source "$OS_ROOT/components/molink/*/Kconfig"

endif

endmenu 
```

## components/molink/api/Kconfig
```kconfig
config MOLINK_USING_GENERAL_OPS
    bool
    default n

config MOLINK_USING_NETSERV_OPS
    bool
    default n

config MOLINK_USING_PING_OPS
    bool
    select MOLINK_USING_IP
    default n

config MOLINK_USING_IFCONFIG_OPS
    bool
    select MOLINK_USING_IP
    default n

config MOLINK_USING_NETCONN_OPS
    bool
    select OS_USING_MESSAGEQUEUE
    select MOLINK_USING_IP
    default n
    
if MOLINK_USING_NETCONN_OPS
    config MOLINK_USING_TCP
        bool
        default n

    config MOLINK_USING_UDP
        bool
        default n

    config MOLINK_USING_SELECT
        bool
        default n

    config MOLINK_USING_DNS
        bool
        default n

    config MOLINK_USING_ADDRINFO
        bool
        select MOLINK_USING_DNS
        default n
endif

config MOLINK_USING_SOCKETS_OPS
    bool
    select MOLINK_USING_NETCONN_OPS
    select OS_USING_LIBC_ADAPTER
    default n

config MOLINK_USING_MQTTC_OPS
    bool
    select OS_USING_MESSAGEQUEUE
    default n

if MOLINK_USING_MQTTC_OPS
    config MOLINK_USING_MQTTC_TASK
    bool
    default n
endif

config MOLINK_USING_ONENET_NB_OPS
    bool
    select MOLINK_USING_IP
    default n

config MOLINK_USING_WIFI_OPS
    bool
    default n

config MOLINK_USING_PPP_OPS
    bool
    default n

config MOLINK_USING_IP
    bool
    default n

    if MOLINK_USING_IP
        config MOLINK_USING_IPV4
        bool
        default y
    endif
```

## components/molink/core/Kconfig
```kconfig
config MOLINK_PLATFORM_MCU
    bool
    select MOLINK_USING_PARSER
    default n

config MOLINK_PLATFORM_OPENCPU
    bool
    default n

config MOLINK_USING_MO_LIB
    bool
    default n

config MOLINK_USING_MO_TIME
    bool
    default n
```

## components/molink/easylog/Kconfig
```kconfig
menu "Easylog"

    config MOLINK_USING_EASYLOG
        bool "Enable molink network log info features"
        default n
        select MOLINK_USING_GENERAL_OPS
        select MOLINK_USING_NETSERV_OPS
        select OS_USING_RTC

    if MOLINK_USING_EASYLOG

        config MOLINK_EASYLOG_USING_IMEI
            bool "Enable easylog imei features"
            depends on MOLINK_USING_GENERAL_OPS
            default y

        config MOLINK_EASYLOG_USING_IMSI
            bool "Enable easylog imsi features"
            depends on MOLINK_USING_GENERAL_OPS
            default y

        config MOLINK_EASYLOG_USING_ICCID
            bool "Enable easylog iccid features"
            depends on MOLINK_USING_GENERAL_OPS
            default y

        config MOLINK_EASYLOG_USING_CSQ
            bool "Enable easylog csq features"
            depends on MOLINK_USING_NETSERV_OPS
            default y


        config MOLINK_EASYLOG_USING_RADIOINFO
            bool "Enable easylog radio info features"
            depends on MOLINK_USING_NETSERV_OPS
            default y

        if MOLINK_EASYLOG_USING_RADIOINFO

            config MOLINK_EASYLOG_USING_PCI
                bool "Enable easylog pci info features"
                depends on MOLINK_USING_NETSERV_OPS
                default y

            config MOLINK_EASYLOG_USING_EARFCN
                bool "Enable easylog earfcn info features"
                depends on MOLINK_USING_NETSERV_OPS
                default y

            config MOLINK_EASYLOG_USING_CELLID
                bool "Enable easylog cell id info features"
                depends on MOLINK_USING_NETSERV_OPS
                default y

            config MOLINK_EASYLOG_USING_RSRP
                bool "Enable easylog rsrp info features"
                depends on MOLINK_USING_NETSERV_OPS
                default y

            config MOLINK_EASYLOG_USING_RSRQ
                bool "Enable easylog rsrq info features"
                depends on MOLINK_USING_NETSERV_OPS
                default y

            config MOLINK_EASYLOG_USING_SNR
                bool "Enable easylog snr info features"
                depends on MOLINK_USING_NETSERV_OPS
                default y

            config MOLINK_EASYLOG_USING_TX_PWR
                bool "Enable easylog tx power info features"
                depends on MOLINK_USING_NETSERV_OPS
                default y

            config MOLINK_EASYLOG_USING_ECL
                bool "Enable easylog ecl info features"
                depends on MOLINK_USING_NETSERV_OPS
                default y

        endif

        config MOLINK_EASYLOG_USING_USER_DATA
            bool "Enable easylog user-defined data area"
            default n

        if MOLINK_EASYLOG_USING_USER_DATA

            config MO_EASYLOG_USER_DATA_LEN
                int "Define easylog user-defined data area len"
                default 8

        endif

        config MOLINK_EASYLOG_USING_CHECKSUM
            bool "Enable easylog info checksum features"
            default n

        config MOLINK_EASYLOG_INFO_PRINTF
            bool "Enable easylog info printf features"
            default n

    endif

endmenu
```
