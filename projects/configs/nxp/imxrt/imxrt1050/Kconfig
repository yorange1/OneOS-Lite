## projects/configs/nxp/imxrt/imxrt1050/Kconfig
```kconfig
choice
    prompt "|------MODEL"
        default MODEL_IMXRT1052
    help
        Select the device in IMXRT1050

    config MODEL_IMXRT1052
        bool "IMXRT1052"
        
    config MODEL_IMXRT1051
        bool "IMXRT1051"

endchoice

if MODEL_IMXRT1052
    source "$OS_ROOT/templates/configs/nxp/imxrt/imxrt1050/imxrt1052/Kconfig"
endif

if MODEL_IMXRT1051
    #source "$OS_ROOT/templates/configs/nxp/imxrt/imxrt1050/imxrt1051/Kconfig"
endif
```

## projects/configs/nxp/imxrt/imxrt1050/imxrt1051/Kconfig
```kconfig
choice
    prompt "|--------SUB MODEL"
        default TEMP_IMXRT1052CVJ5B
    help
        Select the device in IMXRT1052

    config TEMP_IMXRT1052CVJ5B
        bool "IMXRT1052CVJ5B"
        
    config TEMP_IMXRT1052CVL5B
        bool "IMXRT1052CVL5B"

    config TEMP_IMXRT1052DVJ5B
        bool "IMXRT1052DVJ5B"
     
    config TEMP_IMXRT1052DVL5B
        bool "IMXRT1052DVL5B"
        
    config TEMP_imxrt1052-nxp-evk
        bool "imxrt1052-nxp-evk"
endchoice
```

## projects/configs/nxp/lpc/Kconfig
```kconfig
choice
    prompt "|----SERIES"
        default SERIES_NXP_LPC5500
    help
        Select the device in nxp lpc series
        
    config SERIES_NXP_LPC5500
        bool "LPC5500"
    
    config SERIES_NXP_LPC4000
        bool "LPC4000"
        
endchoice

if SERIES_NXP_LPC5500
    source "$OS_ROOT/templates/configs/nxp/lpc/lpc5500/Kconfig"
endif

if SERIES_NXP_LPC4000
    #source "$OS_ROOT/templates/configs/nxp/lpc/lpc4000/Kconfig"
endif
        
```

## projects/configs/nxp/lpc/lpc5500/Kconfig
```kconfig
choice
    prompt "|------MODEL"
        default MODEL_LPC55S69
    help
        Select the device in LPC5500

    config MODEL_LPC55S69
        bool "LPC55S69"
        
    config MODEL_LPC55S66
        bool "LPC55S66"

endchoice

if MODEL_LPC55S69
    source "$OS_ROOT/templates/configs/nxp/lpc/lpc5500/lpc55s69/Kconfig"
endif

if MODEL_LPC55S66
    source "$OS_ROOT/templates/configs/nxp/lpc/lpc5500/lpc55s66/Kconfig"
endif
```

## projects/configs/nxp/lpc/lpc5500/lpc55s66/Kconfig
```kconfig
choice
    prompt "|--------SUB MODEL"
        default TEMP_LPC55S66JBD
    help
        Select the device in LPC55S66xx

    config TEMP_LPC55S66JBD
        bool "LPC55S66JBD"
        
    config TEMP_LPC55S66JET
        bool "LPC55S66JET"
        
endchoice
```

## projects/configs/nxp/lpc/lpc5500/lpc55s69/Kconfig
```kconfig
choice
    prompt "|--------SUB MODEL"
        default TEMP_LPC55S69JBD
    help
        Select the device in LPC55S69xx

    config TEMP_LPC55S69JBD
        bool "LPC55S69JBD"
        
    config TEMP_LPC55S69JET
        bool "LPC55S69JET"

    config TEMP_lpc55s69-nxp-evk
        bool "lpc55s69-nxp-exk"
        
    config TEMP_lpc55s69-cmcc-oneos
        bool "lpc55s69-cmcc-oneos"
endchoice
```

## projects/configs/st/f0/Kconfig
```kconfig
choice
    prompt "|----MODEL"
        default MODEL_STM32F091
    help
        Select the device in STM32F0xx

    config MODEL_STM32F091
        bool "STM32F091"

endchoice

if MODEL_STM32F091
    source "$OS_ROOT/templates/configs/st/f0/f091/Kconfig"
endif
```

## projects/configs/st/f0/f091/Kconfig
```kconfig
choice
    prompt "|------SUB MODEL"
        default TEMP_stm32f091-nucleo-64
    help
        Select the device in STM32F091xx

    config TEMP_stm32f091-nucleo-64
        bool "stm32f091-nucleo-64"
    
endchoice
```

## projects/configs/st/f3/Kconfig
```kconfig
choice
    prompt "|----MODEL"
        default MODEL_STM32F302
    help
        Select the device in STM32F3xx

    config MODEL_STM32F302
        bool "STM32F302"

	config MODEL_STM32F303
        bool "STM32F303"

	config MODEL_STM32F334
        bool "STM32F334"

endchoice

if MODEL_STM32F302
    source "$OS_ROOT/templates/configs/st/f3/f302/Kconfig"
endif

if MODEL_STM32F303
    source "$OS_ROOT/templates/configs/st/f3/f303/Kconfig"
endif

if MODEL_STM32F334
    source "$OS_ROOT/templates/configs/st/f3/f334/Kconfig"
endif
```

## projects/configs/st/f3/f302/Kconfig
```kconfig
choice
    prompt "|------SUB MODEL"
        default TEMP_stm32f302-nucleo
    help
        Select the device in STM32F302xx

    config TEMP_stm32f302-nucleo
        bool "stm32f302-nucleo"
        
endchoice
```

## projects/configs/st/f3/f303/Kconfig
```kconfig
choice
    prompt "|------SUB MODEL"
        default TEMP_stm32f303-k8t6-nucleo
    help
        Select the device in STM32F303xx

    config TEMP_stm32f303-k8t6-nucleo
        bool "stm32f303-k8t6-nucleo"

endchoice
```

## projects/configs/st/f3/f334/Kconfig
```kconfig
choice
    prompt "|------SUB MODEL"
        default TEMP_stm32f334-r8t6-nucleo
    help
        Select the device in STM32F334xx

    config TEMP_stm32f334-r8t6-nucleo
        bool "stm32f334-r8t6-nucleo"

endchoice
```

## projects/configs/st/g0/Kconfig
```kconfig
choice
    prompt "|----MODEL"
        default MODEL_STM32G071
    help
        Select the device in STM32G0xx

    config MODEL_STM32G071
        bool "STM32G071"

endchoice

if MODEL_STM32G071
    source "$OS_ROOT/templates/configs/st/g0/g071/Kconfig"
endif
```

## projects/configs/st/g0/g071/Kconfig
```kconfig
choice
    prompt "|------SUB MODEL"
        default TEMP_stm32g071-nucleo-64
    help
        Select the device in STM32G071xx

    config TEMP_stm32g071-nucleo-64
        bool "stm32g071-nucleo-64"
    
endchoice
```

## projects/configs/st/l0/Kconfig
```kconfig
choice
    prompt "|----MODEL"
        default MODEL_STM32L053
    help
        Select the device in STM32L0xx

    config MODEL_STM32L053
        bool "STM32L053"

endchoice

if MODEL_STM32L053
    source "$OS_ROOT/templates/configs/st/l0/l053/Kconfig"
endif
```

## projects/configs/st/l1/Kconfig
```kconfig
choice
    prompt "|----MODEL"
        default MODEL_STM32L152
    help
        Select the device in STM32L0xx

    config MODEL_STM32L152
        bool "STM32L152"

endchoice

if MODEL_STM32L152
    source "$OS_ROOT/templates/configs/st/l1/l152/Kconfig"
endif
```

## projects/configs/st/mp1/mp157/Kconfig
```kconfig
choice
    prompt "|------SUB MODEL"
        default TEMP_STM32MP157DAAx
    help
        Select the device in STM32MP157xx

    config TEMP_STM32MP157DAAx
        bool "STM32MP157DAAx"
        
    config TEMP_stm32mp157daa1-base
        bool "stm32mp157daa1-base"
endchoice
```

## thirdparty/module/Kconfig
```kconfig
menu "Submodule"
    config OS_USING_SUBMODULE
        bool "submodule"
        default y
endmenu
```
