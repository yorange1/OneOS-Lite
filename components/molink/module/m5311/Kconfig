## drivers/hal/hdsc/drivers/Kconfig
```kconfig
menuconfig BSP_BOOT_OPTION
    bool "boot config"
    default n
    
    if BSP_BOOT_OPTION
        config BSP_TEXT_SECTION_ADDR
            hex "text section addr"
            default 0x08000000
            
        config BSP_TEXT_SECTION_SIZE
            hex "text section size"
            default 0x00080000
            
        config BSP_DATA_SECTION_ADDR
            hex "data section addr"
            default 0x20000000
            
        config BSP_DATA_SECTION_SIZE
            hex "data section size"
            default 0x00008000
    endif
    config BSP_USING_GPIO
        bool "GPIO"
        select OS_USING_PIN
        default y
	
    menuconfig BSP_USING_UART
        bool "UART"
        default y
        select OS_USING_SERIAL
        if BSP_USING_UART
            config BSP_USING_LPUART0
                bool "LPUART0"
                default n
            config BSP_USING_LPUART1
                bool "LPUART1"
                default n
            config BSP_USING_UART0
                bool "UART0"
                default n
            config BSP_USING_UART1
                bool "UART1"
                default y
            config BSP_USING_UART2
                bool "UART2"
                default n
            config BSP_USING_UART3
                bool "UART3"
                default n
        endif

    menu "Select I2C port"
        depends on OS_USING_I2C
        config BSP_USING_I2C0
            bool "I2C0"
            default y

        config BSP_USING_I2C1
            bool "I2C1"
            default n
    endmenu

    menu "Select SPI port"
        depends on OS_USING_SPI
        config BSP_USING_SPI0
            bool "SPI0"
            default y

        config BSP_USING_SPI1
            bool "SPI1"
            default n
    endmenu

    menu "Select LPTIMER port"
        depends on OS_USING_CLOCKEVENT
        config BSP_USING_LPTIM0
            bool "LPTIM0"
            default y

        config BSP_USING_LPTIM1
            bool "LPTIM1"
            default n
    endmenu

    config BSP_USING_ON_CHIP_FLASH
        bool "on-chip FLASH"
        select OS_USING_FAL
        default y
```

## drivers/hal/hk32/drivers/Kconfig
```kconfig
menuconfig BSP_BOOT_OPTION
    bool "Board boot configure"
    default n
    
    if BSP_BOOT_OPTION
        config BSP_TEXT_SECTION_ADDR
            hex "text section addr"
            default 0x08000000
            
        config BSP_TEXT_SECTION_SIZE
            hex "text section size"
            default 0x00080000
            
        config BSP_DATA_SECTION_ADDR
            hex "data section addr"
            default 0x20000000
            
        config BSP_DATA_SECTION_SIZE
            hex "data section size"
            default 0x00008000
    endif
config BSP_USING_PIN
    bool "pin"
    select OS_USING_PIN
    default n
    
config BSP_USING_USART
    bool "usart"
    select OS_USING_SERIAL
    default n
    
    if BSP_USING_USART
        config BSP_USING_USART1
            bool "usart1"
            default n
            
        config BSP_USING_USART2
            bool "usart2"
            default n
            
        config BSP_USING_USART3
            bool "usart3"
            default n
    endif
    
config BSP_USING_TIMER
    bool "timer"
    select OS_USING_TIMER_DRIVER
    default n
    
    if BSP_USING_TIMER
        
        config BSP_USING_TIMER2
            bool "timer2"
            depends on SERIES_HK32F1
            default n
            
        config BSP_USING_TIMER3
            bool "timer3"
            depends on (SERIES_HK32F0 || SERIES_HK32F1)
            default n
            
        config BSP_USING_TIMER4
            bool "timer4"
            depends on SERIES_HK32F1
            default n
            
        config BSP_USING_TIMER6
            bool "timer6"
            depends on (SERIES_HK32F0 || SERIES_HK32F1)
            default n
            
        config BSP_USING_TIMER14
            bool "timer14"
            depends on SERIES_HK32F0
            default n
            
        config BSP_USING_TIMER15
            bool "timer15"
            depends on SERIES_HK32F0
            default n
            
        config BSP_USING_TIMER16
            bool "timer16"
            depends on SERIES_HK32F0
            default n
            
        config BSP_USING_TIMER17
            bool "timer17"
            depends on SERIES_HK32F0
            default n
       
    endif
    
config BSP_USING_FLASH
    bool "on chip flash"
    select OS_USING_FAL
    default n
    
```

## drivers/hal/mm32/Kconfig
```kconfig
config MANUFACTOR_MM32
    bool
    default n

config SERIES_MM32F013XX
    bool
    select MANUFACTOR_MM32
    select ARCH_ARM_CORTEX_M0
    default n

config SERIES_MM32F027XX
    bool
    select MANUFACTOR_MM32
    select ARCH_ARM_CORTEX_M0
    default n
    
config SERIES_MM32F103XX
    bool
    select MANUFACTOR_MM32
    select ARCH_ARM_CORTEX_M3
    default n

config SERIES_MM32F327XX
    bool
    select MANUFACTOR_MM32
    select ARCH_ARM_CORTEX_M3
    default n
    
config SERIES_MM32L3XX
    bool
    select MANUFACTOR_MM32
    select ARCH_ARM_CORTEX_M3
    default n

config SERIES_MM32SPIN0XX
    bool
    select MANUFACTOR_MM32
    select ARCH_ARM_CORTEX_M0
    default n

config SERIES_MM32SPIN2XX
    bool
    select MANUFACTOR_MM32
    select ARCH_ARM_CORTEX_M0
    default n

config SERIES_MM32W3XX
    bool
    select MANUFACTOR_MM32
    select SERIES_MM32L3XX
    select ARCH_ARM_CORTEX_M3
    default n
    
source "$OS_ROOT/drivers/hal/mm32/*/Kconfig"
```
