## components/molink/module/m5311/Kconfig
```kconfig
menu "Config" 

    config M5311_USING_GENERAL_OPS
        bool "General Operates"
        select MOLINK_USING_GENERAL_OPS
        select MOLINK_USING_MO_TIME
        default n
    
    config M5311_USING_NETSERV_OPS
        bool "Network Service"
        select MOLINK_USING_NETSERV_OPS
        default n

    config M5311_USING_PING_OPS
        bool #"Ping"
        select MOLINK_USING_PING_OPS
        default n

    config M5311_USING_IFCONFIG_OPS
        bool #"Ifconfig"
        select MOLINK_USING_IFCONFIG_OPS
        select M5311_USING_GENERAL_OPS
        select M5311_USING_NETSERV_OPS
        default n

    config M5311_USING_NETCONN_OPS
        bool "Netconn Options"
        select MOLINK_USING_NETCONN_OPS
        select MOLINK_USING_MO_LIB
        default y

    if M5311_USING_NETCONN_OPS
        config M5311_USING_TCP
            bool "TCP"
            select MOLINK_USING_TCP
            default y

        config M5311_USING_UDP
            bool "UDP"
            select MOLINK_USING_UDP
            default y

        config M5311_USING_SELECT
            bool "Select"
            select MOLINK_USING_SELECT
            default n

        config M5311_USING_DNS
            bool "DNS"
            select MOLINK_USING_DNS
            default y

        config M5311_USING_ADDRINFO
            bool "AddrInfo"
            select M5311_USING_DNS
            select MOLINK_USING_ADDRINFO
            default n
    endif

    config M5311_USING_SOCKETS_OPS
        bool "BSD Socket"
        select M5311_USING_NETCONN_OPS
        select MOLINK_USING_SOCKETS_OPS
        default n

    config M5311_USING_ONENET_NB_OPS
        bool "Onenet Nb"
        select MOLINK_USING_ONENET_NB_OPS
        default y

endmenu
```

## components/molink/module/me3616/Kconfig
```kconfig
menu "Config" 

    config ME3616_USING_GENERAL_OPS
        bool "General Operates"
        select MOLINK_USING_GENERAL_OPS
        default n
    
    config ME3616_USING_NETSERV_OPS
        bool "Network Service"
        select MOLINK_USING_NETSERV_OPS
        default n

    config ME3616_USING_IFCONFIG_OPS
        bool #"Ifconfig"
        select MOLINK_USING_IFCONFIG_OPS
        select ME3616_USING_GENERAL_OPS
        select ME3616_USING_NETSERV_OPS
        default n

    config ME3616_USING_PING_OPS
        bool #"Ping"
        select MOLINK_USING_PING_OPS
        default n

    config ME3616_USING_NETCONN_OPS
        bool "Netconn Options"
        select MOLINK_USING_NETCONN_OPS
        select MOLINK_USING_MO_LIB
        default y

    if ME3616_USING_NETCONN_OPS
        config ME3616_USING_TCP
            bool "TCP"
            select MOLINK_USING_TCP
            default y

        config ME3616_USING_UDP
            bool "UDP"
            select MOLINK_USING_UDP
            default y

        config ME3616_USING_SELECT
            bool "Select"
            select MOLINK_USING_SELECT
            default n

        config ME3616_USING_DNS
            bool "DNS"
            select MOLINK_USING_DNS
            default y

        config ME3616_USING_ADDRINFO
            bool "AddrInfo"
            select ME3616_USING_DNS
            select MOLINK_USING_ADDRINFO
            default n
    endif

    config ME3616_USING_SOCKETS_OPS
        bool "BSD Socket"
        select ME3616_USING_NETCONN_OPS
        select MOLINK_USING_SOCKETS_OPS
        default n

endmenu
```

## components/molink/module/me3630_w/Kconfig
```kconfig
menu "Config" 

    config ME3630_W_USING_GENERAL_OPS
        bool "General Operates"
        select MOLINK_USING_GENERAL_OPS
        default n
    
    config ME3630_W_USING_NETSERV_OPS
        bool "Network Service"
        select MOLINK_USING_NETSERV_OPS
        default n

    config ME3630_W_USING_IFCONFIG_OPS
        bool #"Ifconfig"
        select MOLINK_USING_IFCONFIG_OPS
        select ME3630_W_USING_GENERAL_OPS
        select ME3630_W_USING_NETSERV_OPS
        default n

    config ME3630_W_USING_NETCONN_OPS
        bool "Netconn Options"
        select MOLINK_USING_NETCONN_OPS
        default y

    if ME3630_W_USING_NETCONN_OPS
        config ME3630_W_USING_TCP
            bool "TCP"
            select MOLINK_USING_TCP
            default y

        config ME3630_W_USING_UDP
            bool "UDP"
            select MOLINK_USING_UDP
            default y

        config ME3630_W_USING_SELECT
            bool "Select"
            select MOLINK_USING_SELECT
            default n

        config ME3630_W_USING_DNS
            bool "DNS"
            select MOLINK_USING_DNS
            default y

        config ME3630_W_USING_ADDRINFO
            bool "AddrInfo"
            select ME3630_W_USING_DNS
            select MOLINK_USING_ADDRINFO
            default n
    endif

    config ME3630_W_USING_SOCKETS_OPS
        bool "BSD Socket"
        select ME3630_W_USING_NETCONN_OPS
        select MOLINK_USING_SOCKETS_OPS
        default n

endmenu
```

## components/molink/module/ml302/Kconfig
```kconfig
menu "Config" 

    config ML302_USING_GENERAL_OPS
        bool "General Operates"
        select MOLINK_USING_GENERAL_OPS
        default n
    
    config ML302_USING_NETSERV_OPS
        bool "Network Service"
        select MOLINK_USING_NETSERV_OPS
        default n

    config ML302_USING_PING_OPS
        bool #"Ping"
        select MOLINK_USING_PING_OPS
        default n

    config ML302_USING_IFCONFIG_OPS
        bool #"Ifconfig"
        select MOLINK_USING_IFCONFIG_OPS
        select ML302_USING_GENERAL_OPS
        select ML302_USING_NETSERV_OPS
        default n

    config ML302_USING_NETCONN_OPS
        bool "Network Service"
        select MOLINK_USING_NETCONN_OPS
        default y

    if ML302_USING_NETCONN_OPS
        config ML302_USING_TCP
            bool "TCP"
            select MOLINK_USING_TCP
            default y

        config ML302_USING_UDP
            bool "UDP"
            select MOLINK_USING_UDP
            default y

        config ML302_USING_SELECT
            bool "Select"
            select MOLINK_USING_SELECT
            default n

        config ML302_USING_DNS
            bool "DNS"
            select MOLINK_USING_DNS
            default y

        config ML302_USING_ADDRINFO
            bool "AddrInfo"
            select ML302_USING_DNS
            select MOLINK_USING_ADDRINFO
            default n
    endif

    config ML302_USING_SOCKETS_OPS
        bool "BSD Socket"
        select ML302_USING_NETCONN_OPS
        select MOLINK_USING_SOCKETS_OPS
        default n

#    config ML302_USING_MQTTC_OPS
#        bool "MQTT Client"
#        select MOLINK_USING_MQTTC_OPS
#        default n
#
#    if ML302_USING_MQTTC_OPS
#
#        config ML302_USING_MQTTC_TASK
#        bool "MQTT Client Task"
#        select MOLINK_USING_MQTTC_TASK
#        default n
#    endif

endmenu
```

## components/molink/module/sim7600ce/Kconfig
```kconfig
menu "Config"

    config SIM7600CE_USING_GENERAL_OPS
        bool "General Operates"
        select MOLINK_USING_GENERAL_OPS
        default n

    config SIM7600CE_USING_NETSERV_OPS
        bool "Network Service"
        select MOLINK_USING_NETSERV_OPS
        default n

    config SIM7600CE_USING_PING_OPS
        bool #"Ping"
        select MOLINK_USING_PING_OPS
        default n

    config SIM7600CE_USING_IFCONFIG_OPS
        bool #"Ifconfig"
        select MOLINK_USING_IFCONFIG_OPS
        select SIM7600CE_USING_GENERAL_OPS
        select SIM7600CE_USING_NETSERV_OPS
        default n

    config SIM7600CE_USING_NETCONN_OPS
        bool "Netconn Options"
        select MOLINK_USING_NETCONN_OPS
        default y

    if SIM7600CE_USING_NETCONN_OPS
        config SIM7600CE_USING_TCP
            bool "TCP"
            select MOLINK_USING_TCP
            default y

        config SIM7600CE_USING_UDP
            bool "UDP"
            select MOLINK_USING_UDP
            default y

        config SIM7600CE_USING_SELECT
            bool "Select"
            select MOLINK_USING_SELECT
            default n

        config SIM7600CE_USING_DNS
            bool "DNS"
            select MOLINK_USING_DNS
            default y

        config SIM7600CE_USING_ADDRINFO
            bool "AddrInfo"
            select SIM7600CE_USING_DNS
            select MOLINK_USING_ADDRINFO
            default n
    endif

    config SIM7600CE_USING_SOCKETS_OPS
        bool "BSD Socket"
        select SIM7600CE_USING_NETCONN_OPS
        select MOLINK_USING_SOCKETS_OPS
        default y

endmenu
```

## components/molink/parser/Kconfig
```kconfig
menu "Parser"

config MOLINK_USING_PARSER
    bool "AT parser"
    select OS_USING_MESSAGEQUEUE
    select OS_USING_SEMAPHORE
    select OS_USING_EVENT
    select OS_USING_MUTEX
    default n

if MOLINK_USING_PARSER
        config AT_PARSER_TASK_STACK_SIZE
            int "AT parser task stack size"
            default 512

        config AT_PARSER_PRINT_RAW
            bool "print AT data flow"
            default n
            select DLOG_USING_ISR_LOG if OS_USING_DLOG 
endif

endmenu
```

## components/shell/Kconfig
```kconfig
menu "Shell"
    config OS_USING_SHELL
        bool "shell"
        default n

    if OS_USING_SHELL
        config SHELL_TASK_NAME
            string #"shell task name"
            default "shell"

        config SHELL_TASK_PRIORITY
            int #"priority level value of shell task"
            default 5  if OS_MINIMAL_CONFIG
            default 5   if OS_TASK_PRIORITY_8
            default 10  if OS_TASK_PRIORITY_16
            default 20  if OS_TASK_PRIORITY_32
            default 40  if OS_TASK_PRIORITY_64
            default 80  if OS_TASK_PRIORITY_128
            default 160 if OS_TASK_PRIORITY_256

        config SHELL_TASK_STACK_SIZE
            int "shell task stack size"
            default 1024

        config SHELL_USING_HISTORY
            bool #"command history feature"
            default n

        if SHELL_USING_HISTORY
            config SHELL_HISTORY_LINES
                int #"command history line number"
                default 5
        endif

        config SHELL_USING_DESCRIPTION
            bool #"Keep description in symbol table"
            default y

        config SHELL_CMD_SIZE
            int "command line size"
            default 80

        config SHELL_PROMPT_SIZE
            int "prompt line size"
            default 256

        config SHELL_ARG_MAX
            int #"command arg num"
            default 10

        config SHELL_PROMPT_DISABLE
            bool "disable prompt mode"
            default n

        config SHELL_ECHO_DISABLE
            bool "disable echo mode"
            default n

        config SHELL_USING_AUTH
            bool #"Shell support authentication"
            default n
        if SHELL_USING_AUTH
            config SHELL_PASSWORD_MIN
                int #"password min length"
                default 6
            config SHELL_PASSWORD_MAX
                int #"password max length"
                default OS_NAME_MAX
            config SHELL_DEFAULT_PASSWORD
                string #"default password for shell authentication"
                default ""
        endif
    endif
endmenu
```

## components/socket/Kconfig
```kconfig
menu "Socket"

config NET_USING_BSD
    bool "BSD socket"
    default n

    if NET_USING_BSD
        if NET_USING_MOLINK

            config BSD_USING_MOLINK
                bool #"Molink"
                default y
                depends on MOLINK_USING_SOCKETS_OPS
        endif
    endif

endmenu
```

## drivers/Kconfig
```kconfig
menu "Drivers"
menu "Device"
    config OS_USING_DEVICE
        bool "using device"
        default y
    config OS_DEVICE_NAME_MAX
        int "max device length"
        default 15

    config OS_USING_DEVICE_BLOCK
        bool "device block"
        default n
    config OS_USING_DRIVER_SIMPLE
        bool "device simple"
        default y
endmenu
    source "$OS_ROOT/drivers/fal/Kconfig"
    source "$OS_ROOT/drivers/console/Kconfig"
    source "$OS_ROOT/drivers/serial/Kconfig"
    source "$OS_ROOT/drivers/timer/Kconfig"
    source "$OS_ROOT/drivers/lpmgr/Kconfig"
    source "$OS_ROOT/drivers/misc/Kconfig"
    source "$OS_ROOT/drivers/pin/Kconfig"
    source "$OS_ROOT/drivers/hal/Kconfig"
endmenu
```

## drivers/console/Kconfig
```kconfig
menu "Console"
    config OS_USING_CONSOLE
        bool "console"
        depends on OS_USING_DEVICE
        select OS_DEBUG
        default y

    if OS_USING_CONSOLE
        config OS_CONSOLE_DEVICE_NAME
            string "name"
            default "uart1"

        config OS_LOG_BUFF_SIZE
            int "os_kprintf buffer size"
            range 128 384
            default 256
    endif
endmenu
```

## drivers/dma/Kconfig
```kconfig
menu "DMA"

    config OS_USING_DMA
        bool "Enable DMA"
        default n
        
        
    if OS_USING_DMA
    
        config OS_USING_DMA_RAM
            bool "Enable DMA RAM"
            default y
        
        config OS_USING_SOFT_DMA
            bool "Enable soft DMA"
            default n
        
    endif
        
endmenu
```

## drivers/hal/gd/drivers/Kconfig
```kconfig
if SERIES_GD32F30X
source "$OS_ROOT/drivers/hal/gd/drivers/f30x/Kconfig"
endif

if SERIES_GD32F4XX
source "$OS_ROOT/drivers/hal/gd/drivers/f4xx/Kconfig"
endif

if SERIES_GD32F403
source "$OS_ROOT/drivers/hal/gd/drivers/f403/Kconfig"
endif

if SERIES_GD32F3X0
source "$OS_ROOT/drivers/hal/gd/drivers/f3x0/Kconfig"
endif

if SERIES_GD32E10X
source "$OS_ROOT/drivers/hal/gd/drivers/e10x/Kconfig"
endif

if SERIES_GD32E50X
source "$OS_ROOT/drivers/hal/gd/drivers/e50x/Kconfig"
endif

source "$OS_ROOT/drivers/hal/gd/drivers/usb/Kconfig"
```

## drivers/hal/hdsc/HC32F072_HAL/Kconfig
```kconfig
config MANUFACTOR_HC32
    bool
    default n

source "$OS_ROOT/drivers/hal/hdsc/HC32F072_HAL/*/Kconfig"
```

## drivers/hal/hdsc/HC32F17x_HAL/Kconfig
```kconfig
config MANUFACTOR_HC32
    bool
    default n

source "$OS_ROOT/drivers/hal/hdsc/HC32F17x_HAL/*/Kconfig"
```

## drivers/hal/hdsc/HC32F19x_HAL/Kconfig
```kconfig
config MANUFACTOR_HC32
    bool
    default n

source "$OS_ROOT/drivers/hal/hdsc/HC32F19x_HAL/*/Kconfig"
```

## drivers/hal/hdsc/HC32L07x_HAL/Kconfig
```kconfig
config MANUFACTOR_HC32
    bool
    default n

source "$OS_ROOT/drivers/hal/hdsc/HC32L07x_HAL/*/Kconfig"
```

## drivers/hal/hdsc/HC32L13x_HAL/Kconfig
```kconfig
config MANUFACTOR_HC32
    bool
    default n

source "$OS_ROOT/drivers/hal/hdsc/HC32L13x_HAL/*/Kconfig"
```

## drivers/hal/hdsc/HC32L17x_HAL/Kconfig
```kconfig
config MANUFACTOR_HC32
    bool
    default n

source "$OS_ROOT/drivers/hal/hdsc/HC32L17x_HAL/*/Kconfig"
```

## drivers/hal/hdsc/HC32L19x_HAL/Kconfig
```kconfig
config MANUFACTOR_HC32
    bool
    default n

source "$OS_ROOT/drivers/hal/hdsc/HC32L19x_HAL/*/Kconfig"
```

## drivers/hal/hdsc/HC32L19x_HAL/hal_drivers/Kconfig
```kconfig
config SERIES_HC32L19
    bool
    select ARCH_ARM_CORTEX_M0
    default n

config SOC_HC32L19X
    bool
    select MANUFACTOR_HC32
    select SERIES_HC32L19
    default n
```
