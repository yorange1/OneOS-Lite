## drivers/hal/mm32/sdk/middleware/Kconfig
```kconfig
if OS_USING_SDIO_MM32
    menuconfig BSP_USING_SDIO
        bool "Enable SDIO"
        select OS_USING_BLOCK
        default n
        if BSP_USING_SDIO
            config BSP_USING_SDIO_SD
                bool "mm32 sdio use in sd"
                select OS_USING_SDIO_SD
                default n
            config BSP_USING_SDIO_MMC
                bool "mm32 sdio use in mmc"
                select OS_USING_SDIO_MMC
                default n
            config BSP_USING_SDIO_SDIO
                bool "mm32 sdio use in sdio"
                select OS_USING_SDIO_SDIO
                default n
        endif
endif
    
    
```

## drivers/hal/nxp/Kconfig
```kconfig
config OS_SDIO_DEVICE_SD
    bool
    default n
config OS_SDIO_DEVICE_MMC
    bool
    default n
config OS_SDIO_DEVICE_SDIO
    bool
    default n
    
if  OS_USING_SDIO_NXP
    menu "nxp sdio config"
        menuconfig OS_USDHC1_ENABLE
            bool "USDHC1 enable"
            default n
            if OS_USDHC1_ENABLE
                config OS_USDHC1_TYPE
                    bool "select usdhc type"
                    default y
                    if OS_USDHC1_TYPE
                        config OS_USDHC1_SD
                            bool "USDHC1 type: sd"
                            select OS_SDIO_DEVICE_SD
                            default n
                        config OS_USDHC1_SDIO
                            bool "USDHC1 type: sdio"
                            select OS_SDIO_DEVICE_SDIO
                            default n
                            if OS_USDHC1_SDIO
                                config OS_SDIO_USDHC2_BLOCK_SIZE
                                int "sdio device block size"
                                default 512
                            endif
                        config OS_USDHC1_MMC
                            bool "USDHC1 type: mmc"
                            select OS_SDIO_DEVICE_MMC
                            default n
                    endif
                config OS_USDHC1_DMA_BUFF_SIZE
                    int "nxp USDHC1 dma buff size"
                    default 32
                config OS_USDHC1_PWR_EN
                    bool "enable nxp USDHC1 pwr"
                    default n
                    if OS_USDHC1_PWR_EN
                        config OS_USDHC1_PWR_PIN
                            int "nxp USDHC1 pwr pin"
                            default 10
                        config OS_USDHC1_PWR_PIN_LEVEL
                            int "nxp USDHC1 pwr pin enable level"
                            default 1
                    endif
                config OS_USDHC1_IRQ_EN
                    bool "enable nxp USDHC1 irq"
                    default n
                    if OS_USDHC1_IRQ_EN
                        config OS_USDHC1_IRQ_PIN
                            int "nxp USDHC1 irq pin"
                            default 10
                        config OS_USDHC1_IRQ_PIN_LEVEL
                            int "nxp USDHC1 irq pin level"
                            default 1
                    endif
            endif
        menuconfig OS_USDHC2_ENABLE
            bool "USDHC2 enable"
            select OS_USDHC1_TYPE
            default n
            if OS_USDHC2_ENABLE
                if OS_USDHC2_TYPE
                    config OS_USDHC2_SD
                        select OS_SDIO_DEVICE_SD
                        bool "USDHC2 type: sd"
                        default n
                    config OS_USDHC2_SDIO
                        bool "USDHC2 type: sdio"
                        select OS_SDIO_DEVICE_SDIO
                        default n
                        if OS_USDHC2_SDIO
                            config OS_SDIO_USDHC2_BLOCK_SIZE
                            int "sdio device block size"
                            default 512
                        endif
                    config OS_USDHC2_MMC
                        bool "USDHC2 type: mmc"
                        select OS_SDIO_DEVICE_MMC
                        default n
                endif
                config OS_USDHC2_DMA_BUFF_SIZE
                    int "nxp USDHC2 dma buff size"
                    default 32
                config OS_USDHC2_PWR_EN
                    bool "enable nxp USDHC2 pwr"
                    default n
                    if OS_USDHC2_PWR_EN
                        config OS_USDHC1_PWR_PIN
                            int "nxp USDHC2 pwr pin"
                            default 10
                        config OS_USDHC2_PWR_PIN_LEVEL
                            int "nxp USDHC2 pwr pin enable level"
                            default 1
                    endif
                config OS_USDHC2_IRQ_EN
                    bool "enable nxp USDHC2 irq"
                    default n
                    if OS_USDHC2_IRQ_EN
                        config OS_USDHC2_IRQ_PIN
                            int "nxp USDHC2 irq pin"
                            default 10
                        config OS_USDHC2_IRQ_PIN_LEVEL
                            int "nxp USDHC2 irq pin level"
                            default 1
                    endif
            endif
        menuconfig OS_USDHC3_ENABLE
            bool "USDHC3 enable"
            select OS_USDHC1_TYPE
            default n
            if OS_USDHC3_ENABLE
                if OS_USDHC3_TYPE
                    config OS_USDHC3_SD
                        bool "USDHC3 type: sd"
                        select OS_SDIO_DEVICE_SD
                        default n
                    config OS_USDHC3_SDIO
                        bool "USDHC3 type: sdio"
                        select OS_SDIO_DEVICE_SDIO
                        default n
                        if OS_USDHC3_SDIO
                            config OS_SDIO_USDHC2_BLOCK_SIZE
                            int "sdio device block size"
                            default 512
                        endif
                    config OS_USDHC3_MMC
                        bool "USDHC3 type: mmc"
                        select OS_SDIO_DEVICE_MMC
                        default n
                endif
                config OS_USDHC3_DMA_BUFF_SIZE
                    int "nxp USDHC3 dma buff size"
                    default 32
                config OS_USDHC3_PWR_EN
                    bool "enable nxp USDHC3 pwr"
                    default n
                    if OS_USDHC3_PWR_EN
                        config OS_USDHC3_PWR_PIN
                            int "nxp USDHC3 pwr pin"
                            default 10
                        config OS_USDHC3_PWR_PIN_LEVEL
                            int "nxp USDHC3 pwr pin enable level"
                            default 1
                    endif
                config OS_USDHC3_IRQ_EN
                    bool "enable nxp USDHC3 irq"
                    default n
                    if OS_USDHC3_IRQ_EN
                        config OS_USDHC1_IRQ_PIN
                            int "nxp USDHC3 irq pin"
                            default 10
                        config OS_USDHC3_IRQ_PIN_LEVEL
                            int "nxp USDHC3 irq pin level"
                            default 1
                    endif
            endif
        menu "help: more sdio config param in drv_sdio_common.h"
        endmenu
    endmenu
endif

source "$OS_ROOT/drivers/hal/nxp/*/Kconfig"
```

## drivers/hal/nxp/imxrt/Kconfig
```kconfig
config SERIES_NXP_IMXRT
    bool
    default n

source "$OS_ROOT/drivers/hal/nxp/imxrt/*/Kconfig"
```

## drivers/hal/nxp/imxrt/sdk/devices/MIMXRT1052/Kconfig
```kconfig
config SOC_IMXRT1052
    bool
    select SERIES_NXP_IMXRT
    default n
    
if SOC_IMXRT1052
    menu "board boot up config"
        config BOARD_BOOTUP_NOR_FLASH
            bool "board use nor flash to boot up"
            default y
        config BOARD_BOOTUP_NAND_FLASH_SEMC
            bool "board use nand flash in semc to boot up"
            default n
        config BOARD_FLASH_SIZE
            hex "flash sdram size"
            default 0x4000000
    endmenu
endif
```

## drivers/hal/nxp/lpc/Kconfig
```kconfig
config SERIES_NXP_LPC
    bool
    default n

source "$OS_ROOT/drivers/hal/nxp/lpc/*/Kconfig"
```

## drivers/hal/st/STM32F0xx_HAL/Kconfig
```kconfig
config SERIES_STM32F0
    bool
    select ARCH_ARM_CORTEX_M0
    default n

config SOC_STM32F0XXX
    bool
    select MANUFACTOR_STM32
    select SERIES_STM32F0
    default n

config SOC_STM32F030xC
    bool
    select MANUFACTOR_STM32
    select SERIES_STM32F0
    default n

config SOC_STM32F091xC
    bool
    select MANUFACTOR_STM32
    select SERIES_STM32F0
    default n
```

## drivers/hal/st/drivers/Kconfig
```kconfig
menuconfig BSP_BOOT_OPTION
    bool "Board boot configure"
    default n
    
    if BSP_BOOT_OPTION
        config BSP_TEXT_SECTION_ADDR
            hex "text section addr"
            default 0x08000000
            
        config BSP_TEXT_SECTION_SIZE
            hex "text section size"
            default 0x00080000
            
        config BSP_DATA_SECTION_ADDR
            hex "data section addr"
            default 0x20000000
            
        config BSP_DATA_SECTION_SIZE
            hex "data section size"
            default 0x00008000
    endif

menuconfig BSP_USING_ETH
    bool "Enable Ethernet"
    select OS_USING_LWIP
    default n
    if BSP_USING_ETH
        comment "config eth hw"
        config ETH_RESET_PIN
            int "ETH reset pin number(default:phy_reset pin -->51)"
            default 51
            
        config ETH_RESET_PIN_ACTIVE_HIGH
            bool "ETH reset pin active level is high"
            default n
        
        choice
            prompt "choose eth hardware"
            default PHY_USING_LAN8720A
            help
                Select the eth hardware

            config PHY_USING_LAN8720A
                bool "LAN8720A"

            config PHY_USING_DM9161CEP
                bool "DM9161CEP"

            config PHY_USING_DP83848C
                bool "DP83848C"
        endchoice
    endif

config DEFAULT_SYSTEM_CLOCK_CONFIG
    bool "default system clock config"
    default n
        
```

## drivers/lpmgr/Kconfig
```kconfig
menu "LPMGR"
    if OS_USING_HRTIMER_FOR_SYSTICK
        comment "please close <Using high-resolution timer for systick> [Drivers --> Timer]"
    endif
    
    if !OS_USING_HRTIMER_FOR_SYSTICK
        config OS_USING_LPMGR
        bool "low power manager drivers"
        default n
        select OS_TIMER_SORT
        
        if OS_USING_LPMGR
            choice
                prompt "Low power options"
                default OS_USING_TICKLESS_LPMGR

                config OS_USING_TICKLESS_LPMGR
                    bool "tickless"
                config OS_USING_SIMPLE_LPM
                    bool "simple"
            endchoice
        endif    
    endif
endmenu
```

## drivers/misc/Kconfig
```kconfig
config OS_USING_PUSH_BUTTON
    bool 
    default y
        
config OS_USING_LED
    bool 
    default y
        
menu "ADC"
config OS_USING_ADC
    bool "ADC"
    default n
endmenu
```

## drivers/pin/Kconfig
```kconfig
config OS_USING_PIN
    bool 
    default y
        
config OS_PIN_MAX_CHIP
    int 
    default 1
    depends on OS_USING_PIN
```

## drivers/sdio/Kconfig
```kconfig
menu "SDIO"
config OS_USING_SDIO
    bool "Using SD/MMC device drivers"
    default n

    if OS_USING_SDIO
        config OS_SDIO_STACK_SIZE
            int "The stack size for sdio irq thread"
            default 512

        config OS_SDIO_TASK_PRIORITY
            int "The priority level value of sdio irq thread"
            default 15

        config OS_MMCSD_STACK_SIZE
            int "The stack size for mmcsd thread"
            default 1024

        config OS_MMCSD_TASK_PREORITY
            int "The priority level value of mmcsd thread"
            default 22

        config OS_MMCSD_MAX_PARTITION
            int "mmcsd max partition"
            default 16
        config OS_SDIO_DEBUG
            bool "Enable SDIO debug log output"
        default n
    endif

config OS_USING_SDIO_NXP
    bool "Using NXP SD/MMC device drivers"
    default n

    if OS_USING_SDIO_NXP
        menuconfig OS_SDIO_TRANSFER_MODE
            bool "nxp sdio transfer mode"
            default y
            if OS_SDIO_TRANSFER_MODE
                config OS_SDIO_MODE_BLOCKING
                    bool "nxp sdio blocking mode"
                    default n
                config OS_SDIO_MODE_NONBLOCKING
                    bool "nxp sdio nonblocking mode"
                    default y
            endif
    endif

config OS_USING_SDIO_MM32
    bool "Using MM32 SD/MMC device drivers"
    default n
    
    if OS_USING_SDIO_MM32
        config OS_USING_SDIO_SD
        bool
            default n
        config OS_USING_SDIO_MMC
        bool
            default n
        config OS_USING_SDIO_SDIO
        bool
            default n
    endif
endmenu
```

## drivers/serial/Kconfig
```kconfig
menu "Serial"
    config OS_USING_SERIAL
        bool "serial drivers"
        default y
        
    if OS_USING_SERIAL
        config OS_SERIAL_IDLE_TIMER
            bool "serial idle timer"
            default n
            select OS_USING_TIMER_SOFT
            
        config OS_SERIAL_DELAY_CLOSE
            bool "serial close after sending"
            default y
            
        config OS_SERIAL_RX_BUFSZ
            int "RX buffer size"
            default 64
            
        config OS_SERIAL_TX_BUFSZ
            int "TX buffer size"
            default 64
    endif
    
endmenu
```
