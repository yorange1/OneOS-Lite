## kernel/Kconfig
```kconfig
menu "Kernel"

choice
    prompt "OS Config"
    default OS_MINIMAL_CONFIG
    help
        If you want to Minimal OS Config,select OS_MINIMAL_CONFIG.
        If you want to Customized OS Config,select OS_CUSTOMIZED_CONFIG.

    config OS_MINIMAL_CONFIG
        bool "minimal"

    config OS_CUSTOMIZED_CONFIG
        bool "customized"
endchoice

if OS_MINIMAL_CONFIG
    config OS_NAME_MAX
        int
        default 0
    config OS_TASK_PRIORITY_MAX
        int
        default 8
    config OS_MAIN_TASK_STACK_SIZE
        int
        default 1300
    config OS_IDLE_TASK_STACK_SIZE
        int
        default 128
    config OS_RECYCLE_TASK_STACK_SIZE
        int
        default 128
    config OS_USING_TIMER
        bool
        default y

        if OS_USING_TIMER
            config OS_TIMER_TASK_STACK_SIZE
                int
                default 256

            config OS_TIMER_SORT
                bool
                default n
        endif

    config OS_USING_MUTEX
        bool
        default n
    config OS_USING_SPINLOCK_CHECK
        bool
        default n
    config OS_USING_SEMAPHORE
        bool
        default y
    config OS_USING_EVENT
        bool
        default n
    config OS_USING_MESSAGEQUEUE
        bool
        default y
    config OS_USING_MAILBOX
        bool
        default n

    config OS_USING_SYS_HEAP
        bool
        default y
        select OS_USING_MEM_HEAP
    config OS_USING_MEM_HEAP
        bool
        default n
    config OS_USING_ALG_SMALL
        bool
        default y
    config OS_MEM_ALGORITHM_MINIMIZATION
        bool
        default y

    config OS_DEBUG
        bool
        select OS_USING_LIBC_ADAPTER
        default y

    config EXCEPTION_SIMPLE_HANDLE
        bool
        default y

    config OS_TICK_PER_SECOND
        int
        default 100
    config OS_SCHEDULE_TIME_SLICE
        int
        default 10
endif

if !OS_MINIMAL_CONFIG

    menu "Task"
        choice
            prompt "os obj max size"
            default OS_NAME_MAX_7
    
            config OS_NAME_MAX_0
                bool "0"
    
            config OS_NAME_MAX_7
                bool "7"
    
            config OS_NAME_MAX_15
                bool "15"
    
            config OS_NAME_MAX_31
                bool "31"
        endchoice
        config OS_NAME_MAX
            int
            default 0  if OS_NAME_MAX_0
            default 7  if OS_NAME_MAX_7
            default 15 if OS_NAME_MAX_15
            default 31 if OS_NAME_MAX_31
    
        choice
            prompt "task priority level"
            default OS_TASK_PRIORITY_8
    
            config OS_TASK_PRIORITY_8
                bool "8"
            config OS_TASK_PRIORITY_16
                bool "16"
            config OS_TASK_PRIORITY_32
                bool "32"
            config OS_TASK_PRIORITY_64
                bool "64"
            config OS_TASK_PRIORITY_128
                bool "128"
            config OS_TASK_PRIORITY_256
                bool "256"
        endchoice
        config OS_TASK_PRIORITY_MAX
            int
            default 8   if OS_TASK_PRIORITY_8
            default 16  if OS_TASK_PRIORITY_16
            default 32  if OS_TASK_PRIORITY_32
            default 64  if OS_TASK_PRIORITY_64
            default 128 if OS_TASK_PRIORITY_128
            default 256 if OS_TASK_PRIORITY_256

        config OS_TICK_PER_SECOND
            int "tick frequency(Hz)"
            range 10 1000
            default 100
            help
                System's tick frequency(Hz).

        config OS_SCHEDULE_TIME_SLICE
            int "task timeslice(tick)"
            range 1 100
            default 10

        config OS_MAIN_TASK_STACK_SIZE
            int "main task stack size"
           default 1300

        config OS_IDLE_TASK_STACK_SIZE
            int "idle task stack size"
            default 128

        config OS_RECYCLE_TASK_STACK_SIZE
            int "recycle task stack size"
            default 128
    endmenu

    menu "Timer"
        config OS_USING_TIMER
            bool "software timer"
            default y
            help
                The timeout function context of soft-timer is under a high priority timer
                task.

            if OS_USING_TIMER
                config OS_TIMER_TASK_STACK_SIZE
                    int "timer task stack size"
                    default 256

                config OS_TIMER_SORT
                    bool "sort"
                    default n
            endif

        config OS_USING_WORKQUEUE
            bool "workqueue"
            depends on OS_USING_TIMER
            default n
                
            if OS_USING_WORKQUEUE
                config OS_USING_SYSTEM_WORKQUEUE
                    bool "system workqueue"
                    default y
                    
                if OS_USING_SYSTEM_WORKQUEUE
                    config OS_SYSTEM_WORKQUEUE_STACK_SIZE
                        int "system workqueue task stack size"
                        default 2048
                        
                    config OS_SYSTEM_WORKQUEUE_PRIORITY
                        int "System workqueue task priority level"
                        default 0 
                endif
            endif
    endmenu

    menu "IPC"
        config OS_USING_MUTEX
            bool "mutex"
            default n

        config OS_USING_SEMAPHORE
            bool "semaphore"
            default y

        config OS_USING_EVENT
            bool "event"
            default n
        
        config OS_USING_MESSAGEQUEUE
            bool "messagequeue"
            default y

        config OS_USING_MAILBOX
            bool "mailbox"
            default n
    endmenu

    menu "Memory"
        config OS_USING_SYS_HEAP
            bool "system memory heap"
            default y
            select OS_USING_MEM_HEAP
            help
                The system memory heap is used for os_malloc/os_free.

        config OS_USING_MEM_HEAP
            bool "memory heap"
            default n
            help
                Independent memory heap, Support combine multi memory together as one memory.


        menu "algorithm"
            config OS_USING_ALG_FIRSTFIT
                bool "firstfit"
                default n
                help
                    This algorithm is suitable for all kinds of memory. For small memory, suggest choose this algorithm first.

            config OS_USING_ALG_BUDDY
                bool "buddy"
                default n
                help
                    This algorithm is only suitable for large memory.

                if OS_USING_ALG_BUDDY
                    config OS_ALG_BUDDY_MAX_BLOCK_SIZE
                        int "Max block size when use buddy algorithm to alloc memory."
                        range 512 1048576
                        default 8192
                        help
                            the max block size when use allocte API to get a mem, should be the exponent of 2, 
                            for example 2048, 4096, 8192, ..., 524288. 
                            The max actual alloc size is OS_ALG_BUDDY_MAX_BLOCK_SIZE - BLK_HEAD_SIZE
                endif

            config OS_USING_ALG_SMALL
                bool "small"
                default y
                help
                    This algorithm occupies less code space and uses less memory space, so it is suitable for boards with relatively scarce resources.
        endmenu

        if OS_USING_ALG_FIRSTFIT || OS_USING_ALG_BUDDY || OS_USING_ALG_SMALL
            config OS_USING_MEM_TRACE
                bool "memory trace"
                default n
                help
                    When enable OS_USING_MEM_TRACE with shell, developer can call cmd memtrace

            config OS_MEM_ALGORITHM_MINIMIZATION
                bool "memory minimal funtion"
                default y
                help
                    The memory allocation algorithm is minimized, and only alloc and free are retained.

            config OS_MEM_STATS
                bool "memory stats"
                default n
                help
                    Statistics of the total size of a memory heap, the maximum used size, the current used size and other information.
        endif

        config OS_USING_MEM_POOL
            bool "memory pool"
            default n
            help
                Support fixed-size-blocks alloction

            if OS_USING_MEM_POOL
                config OS_USING_MP_CHECK_TAG
                    bool "Memory-Pool check tag"
                    default n
                    help
                        when free memory, will check memory block tag.
            endif
    endmenu

    menu "Debug"
    config OS_DEBUG
        bool
        select OS_USING_LIBC_ADAPTER
        default n
        help
            dlog, assert and kernel log depends on this config option
    config OS_USING_ASSERT
        bool "global assert"
        select OS_DEBUG
        default n

    config OS_USING_KERNEL_LOCK_CHECK
        bool "kernel lock check"
        select OS_DEBUG
        select OS_USING_ASSERT
        default n

    config OS_USING_KERNEL_DEBUG
        bool "kernel debug"
        select OS_DEBUG
        default n

        if OS_USING_KERNEL_DEBUG
            choice
                prompt "global log level of kernel"
                default KLOG_GLOBAL_LEVEL_WARNING

                config KLOG_GLOBAL_LEVEL_ERROR
                    bool "Error"
                config KLOG_GLOBAL_LEVEL_WARNING
                    bool "Warning"
                config KLOG_GLOBAL_LEVEL_INFO
                    bool "Infomation"
                config KLOG_GLOBAL_LEVEL_DEBUG
                    bool "Debug"
            endchoice
            config KLOG_GLOBAL_LEVEL
                int
                default 0 if KLOG_GLOBAL_LEVEL_ERROR
                default 1 if KLOG_GLOBAL_LEVEL_WARNING
                default 2 if KLOG_GLOBAL_LEVEL_INFO
                default 3 if KLOG_GLOBAL_LEVEL_DEBUG
                
            config KLOG_USING_COLOR
                bool "color log"
                default y
                help
                    The log will has different color by level
            
            config KLOG_WITH_FUNC_LINE
                bool "kernel log with function name and line number"
                default y
        endif

    config EXCEPTION_SIMPLE_HANDLE
        bool "minimal exception show"
        default y
        help
            exception handling only raises exceptions

    config OS_USING_SPINLOCK_CHECK
        bool "spinlock check"
        default n

    config OBJECT_INIT_REPEAT_CHECK
        bool "object init repeat check"
        default n

    config OS_USING_OVERFLOW_CHECK
        bool "stack overflow check"
        default n
        help
            Enable task stack overflow checking. The stack overflow is checking when
            each task switch.
    endmenu

endif
endmenu
```

## projects/configs/Kconfig
```kconfig
choice
    prompt "MANUFACTOR"
        default MANUFACTOR_MM32
        
    config MANUFACTOR_STM32
        bool "STM32"

    config MANUFACTOR_GD32
        bool "GD32"

    config MANUFACTOR_GD32V
        bool "GD32V"

    config MANUFACTOR_NXP
        bool "NXP"

    config MANUFACTOR_HDSC
        bool "HDSC"

    config MANUFACTOR_HSXP
        bool "HSXP"

    config MANUFACTOR_MM32
        bool "MM32"
        
    config MANUFACTOR_APOLLO
        bool "APOLLO"
        
    config MANUFACTOR_HK32
        bool "HK32"
        
    config MANUFACTOR_INGENIC
        bool "INGENIC"
		
    config MANUFACTOR_NRF
        bool "NRF"
endchoice

if MANUFACTOR_STM32
    source "$OS_ROOT/templates/configs/st/Kconfig"
endif

if MANUFACTOR_GD32
    source "$OS_ROOT/templates/configs/gd/Kconfig"
endif

if MANUFACTOR_GD32V
    source "$OS_ROOT/templates/configs/gd32v/Kconfig"
endif

if MANUFACTOR_NXP
    source "$OS_ROOT/templates/configs/nxp/Kconfig"
endif

if MANUFACTOR_HDSC
    source "$OS_ROOT/templates/configs/hdsc/Kconfig"
endif

if MANUFACTOR_HSXP
    #source "$OS_ROOT/templates/configs/hsxp/Kconfig"
endif

if MANUFACTOR_MM32
    source "$OS_ROOT/templates/configs/mm32/Kconfig"
endif

if MANUFACTOR_APOLLO
    #source "$OS_ROOT/templates/configs/apollo/Kconfig"
endif

if MANUFACTOR_HK32
    source "$OS_ROOT/templates/configs/hk32/Kconfig"
endif

if MANUFACTOR_INGENIC
    source "$OS_ROOT/templates/configs/ingenic/Kconfig"
endif

if MANUFACTOR_NRF
    source "$OS_ROOT/templates/configs/nrf/Kconfig"
endif
```

## projects/configs/apollo/Kconfig
```kconfig
choice
    prompt "|----MODEL"
        default MODEL_APOLLO512
    help
        Select the device in MODEL_APOLLO512

    config MODEL_APOLLO512
        bool "APOLLO512"

endchoice

if MODEL_APOLLO512
    source "$OS_ROOT/templates/configs/apollo/apollo512/Kconfig"
endif
```

## projects/configs/apollo/apollo512/Kconfig
```kconfig
choice
    prompt "|------SUB MODEL"
        default TEMP_apollo_th
    help
        Select the device in apollo512-xx
        
    config TEMP_apollo-th
        bool "apollo-th"
        
endchoice
```

## projects/configs/hdsc/l07/l073/Kconfig
```kconfig
choice
    prompt "|------SUB MODEL"
        default TEMP_HC32L073PATA
    help
        Select the device in HC32L073xxxx

    config TEMP_HC32L073JATA
        bool "HC32L073JATA"

    config TEMP_HC32L073KATA
        bool "HC32L073KATA"

    config TEMP_HC32L073PATA
        bool "HC32L073PATA"

#    config TEMP_hc32l073pata-evb-v11
#        bool "hc32l073pata-evb-v11"

endchoice
```

## projects/configs/mm32/spinxx/Kconfig
```kconfig
choice
    prompt "|----MODEL"
        default TEMP_MM32SPIN320B
    help
        Select the device in MM32SPINXX

    config TEMP_MM32SPIN320B
        bool "MM32SPIN320B"
        
    config TEMP_MM32SPIN360C
        bool "MM32SPIN360C"
        
    config TEMP_MM32SPIN422C
        bool "MM32SPIN422C"
        
    config TEMP_MM32SPIN423C
        bool "MM32SPIN423C"
        
endchoice
```

## projects/configs/nrf/Kconfig
```kconfig
choice
    prompt "|--SERIES"
        default SERIES_NRF5
    help
        Select the device in NRF

    config SERIES_NRF5
        bool "NRF5"
		
endchoice

if SERIES_NRF5
    source "$OS_ROOT/templates/configs/nrf/nrf5/Kconfig"
	#source "$OS_ROOT/templates/configs/st/mp1/Kconfig"
endif
```

## projects/configs/nrf/nrf5/Kconfig
```kconfig
choice
    prompt "|----MODEL"
        default MODEL_NRF52
    help
        Select the device in NRF5

    config MODEL_NRF52
        bool "NRF52"
endchoice

if MODEL_NRF52
    source "$OS_ROOT/templates/configs/nrf/nrf5/nrf52/Kconfig"
endif
```

## projects/configs/nxp/Kconfig
```kconfig
choice
    prompt "|--SERIES"
        default SERIES_NXP_LPC
    help
        Select the device in nxp series
        
    config SERIES_NXP_LPC
        bool "LPC"
    
    config SERIES_NXP_IMXRT
        bool "IMXRT"
        
endchoice

if SERIES_NXP_LPC
    source "$OS_ROOT/templates/configs/nxp/lpc/Kconfig"
endif

if SERIES_NXP_IMXRT
    source "$OS_ROOT/templates/configs/nxp/imxrt/Kconfig"
endif
        
```

## projects/configs/nxp/imxrt/Kconfig
```kconfig
choice
    prompt "|----SERIES"
        default SERIES_NXP_IMXRT1050
    help
        Select the device in nxp imxrt series
        
    config SERIES_NXP_IMXRT1050
        bool "IMXRT1050"
    
    config SERIES_NXP_IMXRT1020
        bool "IMXRT1020"
        
endchoice

if SERIES_NXP_IMXRT1050
    source "$OS_ROOT/templates/configs/nxp/imxrt/imxrt1050/Kconfig"
endif

if SERIES_NXP_IMXRT1020
    #source "$OS_ROOT/templates/configs/nxp/imxrt/imxrt1020/Kconfig"
endif
        
```
